## sample.yaml
```yaml
sample:
  description: Hello World Rust sample, the simplest Zephyr
    application with embedded Rust code
  name: hello world rust
common:
  tags: introduction
  integration_platforms:
    - native_posix
  harness: console
  harness_config:
    type: one_line
    regex:
      - "Hello World! (.*)"
tests:
  sample.basic.helloworldrust:
    tags: introduction
```
